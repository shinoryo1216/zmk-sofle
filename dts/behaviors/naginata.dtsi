#define NG_L1_R3 0x01
#define NG_L1_R4 0x02
#define NG_R6_R3 0x03
#define NG_R6_R4 0x04
#define NG_THUMB_DOT 0x05
#define NG_THUMB_ENTER 0x06
#define NG_R6_R2 0x07

/ {
    ng: naginata {
        compatible = "zmk,behavior-naginata";
        #binding-cells = <1>;
    };
};
